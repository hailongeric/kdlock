## Kconfig
```kconfig
# SPDX-License-Identifier: GPL-2.0-only
config KDLOCK_REBUILD
	bool "kdlock private mutex core for source rebuild"
	depends on X86_64 && !PREEMPT_RT
	select EXECMEM
	help
	  Package the source-rebuilt ordinary mutex core, task-owned storage,
	  immutable-text provider, executable image loader and bounded compiler
	  control channel. The exact Linux 7.0 task fields and lifecycle hooks
	  must already be integrated. Resource counts and complete auxiliary
	  control-stack bounds are explicit provider inputs, without defaults.

	  All admitted source dependencies must remain immutable through their
	  actual native, generated and feedback users. This option supplies no
	  automatic Linux mutex aliases or additional API/context lane, and
	  enabling it establishes no build, execution or performance evidence.
	  See kernel/integration/BUILDING.md in the kdlock package.
```

## kernel_integration/real_api/overlay/kernel/locking/kd_api/Kconfig
```kconfig
config KD_API_LOCKS
	bool "Scoped KD binding for file tables and pipes"
	depends on X86_64 && SMP && FRAME_POINTER && MODULES
	depends on !PREEMPT_RT && !DEBUG_MUTEXES && !DEBUG_SPINLOCK
	depends on !DEBUG_LOCK_ALLOC && !LOCKDEP
	default n
	help
	  Preserve native syscall bodies while binding selected newly created
	  file tables/pipes to one loadable KD provider. All object participants
	  share that immutable backend. This is an experimental scoped interface,
	  not a global lock replacement. Native creation remains the default.
```
