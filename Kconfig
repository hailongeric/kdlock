## Kconfig
```kconfig
# SPDX-License-Identifier: GPL-2.0-only
config KDLOCK_REBUILD
	bool "kdlock private mutex core for source rebuild"
	depends on X86_64 && !PREEMPT_RT
	select EXECMEM
	help
	  Package the source-rebuilt ordinary mutex core, task-owned storage,
	  immutable-text provider, executable image loader and bounded compiler
	  control channel. The exact Linux 7.0 task fields and lifecycle hooks
	  must already be integrated. Resource counts and complete auxiliary
	  control-stack bounds are explicit provider inputs, without defaults.

	  All admitted source dependencies must remain immutable through their
	  actual native, generated and feedback users. This option supplies no
	  automatic Linux mutex selection. Generic rwsem bindings remain explicit;
	  unselected objects keep native behavior. Enabling this option alone
	  establishes no build, execution or performance evidence.
	  See kernel/integration/BUILDING.md in the kdlock package.

config KDLOCK_RW_WAIT_DIAG
	bool "Temporary ordinary rwsem worker wait counters"
	depends on KDLOCK_REBUILD
	default n
	help
	  Add explicit per-task opt-in aggregate counters for the ordinary rwsem
	  diagnostic. The provider owns preallocated rows through complete drain.
	  No event logging, scheduler activation claim or lock policy change.
	  Disabled versus enabled overhead must be measured on the same image.

config KDLOCK_RWSEM_NODE_WAIT
	bool "Ordinary rwsem writers wait for their MCS turn separately"
	depends on KDLOCK_REBUILD
	default n
	help
	  Keep ordinary task-owned uninterruptible native writers off the shared
	  rwsem wait queue until they own their MCS turn and need reader drain or
	  WAKE completion. The predecessor's existing direct task wake supplies
	  turn progress. Selected writers register and recheck before sleeping.
	  Callable, killable and managed writer paths keep their existing waits.
	  This candidate is independent of KDLOCK_RW_WAIT_DIAG and has no measured
	  performance or live-kernel correctness result.
```

## kdlock_claude_version/kernel/Kconfig
```kconfig
# SPDX-License-Identifier: GPL-2.0

config KDLOCK
	bool "kdlock: delegating replacements for spinlock, rwlock, mutex and rwsem"
	depends on X86_64 && SMP
	depends on !PREEMPT_RT
	depends on !DEBUG_SPINLOCK && !DEBUG_MUTEXES && !DEBUG_RWSEMS
	depends on !DEBUG_LOCK_ALLOC && !LOCKDEP
	# Entry stubs change the interrupt flag and preempt count directly.
	depends on !TRACE_IRQFLAGS && !PARAVIRT_XXL
	# A delegated section runs on its origin's stack from another CPU.
	depends on VMAP_STACK
	depends on EXECMEM
	select KALLSYMS_ALL
	help
	  Replace the kernel's blocking primitives with kdlock. Under
	  contention the lock holder executes the critical sections of queued
	  waiters itself, from a relocated copy of their code produced by the
	  userspace translator (jit/kd_daemon.py), so the protected data stays
	  in one CPU's cache.

	  Without the translator running, or for call sites it has not
	  translated, the locks behave as plain queued locks.

	  NR_CPUS must stay below 16384 (queue tail encoding).
```

## kernel/Kconfig
```kconfig
# SPDX-License-Identifier: GPL-2.0

config KDLOCK
	bool "kdlock: delegating replacements for spinlock, rwlock, mutex and rwsem"
	depends on X86_64 && SMP
	depends on !PREEMPT_RT
	depends on !DEBUG_SPINLOCK && !DEBUG_MUTEXES && !DEBUG_RWSEMS
	depends on !DEBUG_LOCK_ALLOC && !LOCKDEP
	# Entry stubs change the interrupt flag and preempt count directly.
	depends on !TRACE_IRQFLAGS && !PARAVIRT_XXL
	# A delegated section runs on its origin's stack from another CPU.
	depends on VMAP_STACK
	depends on EXECMEM
	select KALLSYMS_ALL
	help
	  Replace the kernel's blocking primitives with kdlock. Under
	  contention the lock holder executes the critical sections of queued
	  waiters itself, from a relocated copy of their code produced by the
	  userspace translator (jit/kd_daemon.py), so the protected data stays
	  in one CPU's cache.

	  Without the translator running, or for call sites it has not
	  translated, the locks behave as plain queued locks.

	  NR_CPUS must stay below 16384 (queue tail encoding).

config KDLOCK_CLOBBER_ENTRY
	bool "kdlock: clobber entries for the kd_*_cl() lock calls"
	depends on KDLOCK
	default n
	help
	  The kd_*_cl() macros of include/kdlock/kd_api.h make the lock call
	  from inline assembly that declares every general register except
	  rsp and rbp lost across it, so a waiter's continuation and a
	  delegated section's end are a few words instead of the full register
	  set, and the lock holder fetches fewer cache lines per section.

	  With this off (the default), the macros are the ordinary calls.
	  The entries themselves are always built. Measured gain with it on:
	  2-4% for one-line spinlock and rwlock writer sections, 0.5-2% for
	  the sleeping locks, and a 0.5-0.8% loss for a mutex with sixteen
	  lines (bench/results/kdclaude/clobber-20261116-64cpu/).

config KDLOCK_MM
	bool "kdlock: mm_struct mmap lock as a kdlock rwsem"
	depends on KDLOCK && MMU && !KDLOCK_MMAP
	default n
	help
	  Make mm->mmap_lock a union of the native rw_semaphore and a kdlock
	  rwsem. Each new mm chooses one when it is created, from the kd_mm
	  core parameter (default 0: native). With kdlock, contended mmap
	  writers (mmap, munmap, mprotect, brk, ...) can have their critical
	  section run by the queue head. Static mms stay native.

config KDLOCK_API
	bool "kdlock: switchable lock objects on selected syscall paths"
	depends on KDLOCK
	default n
	help
	  Change the type of a few lock fields to a union of the native lock
	  and the kdlock one, chosen per object when it is initialised (kd_api
	  core parameter, default 0: native): files_struct.file_lock,
	  file_lock_context.flc_lock, pipe_inode_info.mutex, file.f_pos_lock,
	  simple_xattrs.lock and uts_sem (boot parameter kd_uts). The lock calls
	  on these fields are unchanged; a _Generic dispatch at the end of
	  linux/spinlock.h, mutex.h and rwsem.h routes them.

config KDLOCK_ALL
	bool "kdlock: every spinlock, rwlock, mutex and rwsem of the kernel"
	depends on KDLOCK && !KDLOCK_MM && !KDLOCK_API
	# The paravirt slow path and unlock would bypass the redirected
	# queued_spin_*() level.
	depends on !PARAVIRT_SPINLOCKS
	# Reads the native mutex and rwsem owner words.
	depends on !DETECT_HUNG_TASK_BLOCKER
	# Follows task->blocked_on to the native mutex owner.
	depends on !SCHED_PROXY_EXEC
	default n
	help
	  Switch the kernel's lock API as a whole (integration/apply_all.py,
	  docs/KERNEL_INTEGRATION.md 4d). spinlock_t and rwlock_t operations
	  become calls to the kd_spin_*() and kd_read/write_*() entries;
	  raw_spinlock_t and the arch_spin/read/write level take the kd queue
	  algorithm through kd_arch_*(); struct mutex, struct ww_mutex and
	  struct rw_semaphore are kdlock objects of the native size, and
	  kernel/locking/mutex.c and rwsem.c are not built.

	  Delegation still needs the translator. Without it every lock is a
	  plain queued lock; that is the configuration this option has been
	  tested in.
```
